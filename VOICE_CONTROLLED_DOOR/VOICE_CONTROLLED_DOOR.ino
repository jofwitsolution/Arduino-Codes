#include "Talkie.h"

Talkie voice;

const uint8_t spt_WELL[] PROGMEM ={0x80,0x12,0xD4,0x26,0x55,0x4D,0x89,0xAE,0x42,0x45,0x5B,0x0F,0xB2,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0xF1,0x03};
const uint8_t spt_COME[] PROGMEM ={0x0E,0x88,0xCD,0xD4,0x01,0xCE,0xB9,0x38,0x20,0xBA,0x54,0x05,0xC4,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0xFD,0x03};
const uint8_t spt_YOU[] PROGMEM ={0xA5,0xDA,0x0D,0x98,0x23,0x6F,0xF4,0x6A,0x55,0x33,0xA9,0x82,0xC6,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0x00,0x00};
const uint8_t spt_ARE[] PROGMEM ={0xA7,0x70,0xB1,0xCE,0x29,0xD2,0xDD,0xFC,0xE6,0x37,0xBF,0xC5,0xA9,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0x00,0x00};
const uint8_t spt_GOODBYE[] PROGMEM ={0xA9,0x49,0xE1,0x54,0x91,0x2D,0xAF,0x22,0x07,0x55,0x29,0x69,0x7B,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0x00,0x00};
const uint8_t spt_CORRECT[] PROGMEM ={0x0E,0x70,0xC7,0x49,0x00,0x3E,0x86,0xA5,0x58,0x8D,0x2C,0x53,0xCD,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0x00,0x00};
const uint8_t spt_THAT_IS_INCORRECT[] PROGMEM ={0xA5,0x2B,0x51,0x25,0xC8,0x7C,0x9F,0x2A,0x78,0xCD,0xD0,0x7A,0x7A,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0x00,0x00};
const uint8_t spt_AGAIN[] PROGMEM ={0x08,0xD0,0xD1,0xBD,0x55,0xAE,0xA7,0x73,0x54,0xAD,0x53,0xC5,0x18,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0x00,0x00};
const uint8_t spt_TRY[] PROGMEM ={0x0E,0x28,0xA1,0xA2,0x02,0x0E,0x28,0x6D,0xCC,0x03,0x2D,0x56,0x23,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0x00,0x00};

const int latch = 12;
const int redLed = 8;
const int instruction = 5;
const int greenLed = 7;
byte com = 0;
int One = 0;
int Two = 0;
int Three = 0;
bool wrongInput = true;

void setup() {
  // put your setup code here, to run once:
  pinMode(latch, OUTPUT);
  pinMode(redLed, OUTPUT);
  pinMode(instruction, INPUT);
  pinMode(greenLed, OUTPUT);

  digitalWrite(latch, LOW);
  digitalWrite(redLed, LOW);
  digitalWrite(greenLed, LOW);
  
  Serial.begin(9600);
  delay(2000);
  
  Serial.write(0xAA);
  Serial.write(0x37);
  delay(1000);
  Serial.write(0xAA);
  Serial.write(0x22);

}

void loop() {
// put your main code here, to run repeatedly:
  digitalWrite(redLed, HIGH);
  digitalWrite(greenLed, HIGH);
  delay(500);
  digitalWrite(redLed, LOW);
  digitalWrite(greenLed, LOW);
  delay(500);
  digitalWrite(redLed, HIGH);
  digitalWrite(greenLed, HIGH);
  delay(500);
  digitalWrite(redLed, LOW);
  digitalWrite(greenLed, LOW);
  
  while (Serial.available()) {
    com = Serial.read();
    Serial.println(com);
//    switch(com) {
//      case 0x11: digitalWrite(redLed, HIGH);
//      break;
//      case 0x12: digitalWrite(latch, HIGH);
//      break;
//      case 0x13: digitalWrite(greenLed, HIGH);
//      break;
//      case 0x14: onLeds();
//      break;
//      case 0x15: offLeds();
//      break;
//      
//    }

      switch(com) {
      case 0x11: One = 1;
      break;
      case 0x12: Two = 2;
      break;
      case 0x13: Three = 3;
      break;
  }

  // unlock door
  if (Two == 2) {
    digitalWrite(greenLed, HIGH);
    digitalWrite(redLed, LOW);
    digitalWrite(latch, HIGH);
    voice.say(spt_CORRECT);
    delay(1000);
    voice.say(spt_YOU);
    voice.say(spt_ARE);
    //delay(200);   
    digitalWrite(2, LOW);
    voice.say(spt_WELL);
    voice.say(spt_COME);             
    One = 0;
    Two = 0;
     wrongInput = false;
   }

   // lock door
   if (Three == 3) {
    digitalWrite(greenLed, LOW);
    digitalWrite(redLed, HIGH);
    digitalWrite(latch, LOW);
    voice.say(spt_GOODBYE);       
    One = 0;
    Three = 0;
    wrongInput = false;
   }

   // wrong voice input 
   if (wrongInput) {
    for (int i = 0; i<3; i++) {
      digitalWrite(redLed, HIGH);
      delay(400);
      digitalWrite(redLed, LOW);
      delay(400);
    }
    voice.say(spt_THAT_IS_INCORRECT);
    delay(500);
    voice.say(spt_TRY);
    voice.say(spt_AGAIN);
    
   }

   wrongInput = true; // set back to true
  }

 }
